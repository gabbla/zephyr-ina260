## Kconfig
```kconfig
# Copyright (c) 2023 Golioth, Inc.
# SPDX-License-Identifier: Apache-2.0

config INA260
	bool "INA260 Current and Power Monitor"
	default y
	depends on DT_HAS_TI_INA260_ENABLED
	select I2C
	help
	  Enable driver for the INA260 Current and Power Monitor.

config INA260_TRIGGER
	bool "INA260 ALERT pin support"
	depends on INA260
	select GPIO
	help
	  Enable runtime threshold configuration and sensor triggers using the
	  ALERT pin. Callbacks execute on the system work queue. Set alert-gpios
	  in devicetree for each device that uses alerts.

config INA260_FAKE
	bool "Use FFF to simulate communication with INA260 sensor"
	default n
	depends on INA260
	select TEST
	help
	  Replaces the read register operation with a function that
	  returns static data readings

if INA260_FAKE
config TEST_LOGGING_DEFAULTS
	default n
endif
```

## dts/bindings/sensor/ti,ina260.yaml
```yaml
# Copyright (c) 2023 Golioth, Inc.
# SPDX-License-Identifier: Apache-2.0

description: |
    The INA260 is a digital-output, current, power, and voltage monitor with an i2C interface

compatible: "ti,ina260"

include: [sensor-device.yaml, i2c-device.yaml]

properties:
  alert-gpios:
    type: phandle-array
    description: |
      GPIO connected to the active-low, open-drain ALERT output. Specify
      GPIO_ACTIVE_LOW and provide a pull-up resistor (or GPIO_PULL_UP).
```
